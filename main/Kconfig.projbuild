## main/Kconfig.projbuild
```kconfig
menu "Project Configuration"

    config ESP_WIFI_SSID
        string "WiFi SSID"
        default "ssid"
        help
            SSID (network name) for the example to connect to.

    config ESP_WIFI_PASSWORD
        string "WiFi Password"
        default "password"
        help
            WiFi password (WPA or WPA2) for the example to use.

    config UDP_PORT
        int "UDP Port"
        range 0 65535
        default 3333
        help
            Local port the UDP server will listen on.

    config IPV4
        bool "IPV4"
        default y

    config IPV6
        bool "IPV6"
        default n
        select EXAMPLE_CONNECT_IPV6

    config TCP_PORT
        int "TCP Port"
        range 0 65535
        default 3334
        help
            Local port the TCP server will listen on.

    config KEEPALIVE_IDLE
        int "TCP keep-alive idle time(s)"
        default 5
        help
            Keep-alive idle time. In idle time without receiving any data from peer, will send keep-alive probe packet

    config KEEPALIVE_INTERVAL
        int "TCP keep-alive interval time(s)"
        default 5
        help
            Keep-alive probe packet interval time.

    config KEEPALIVE_COUNT
        int "TCP keep-alive packet retry send counts"
        default 3
        help
            Keep-alive probe packet retry count.

endmenu
```
